## boards/shields/adept/Kconfig.defconfig
```kconfig
if SHIELD_ADEPT

config ZMK_KEYBOARD_NAME
    default "Adept"

config SPI
    default y

config ZMK_POINTING
    default y

config BT_DEVICE_APPEARANCE
    default 962

config PMW3610_ALT
    default y

config PMW3610_ALT_SMART_ALGORITHM
    default y

endif
```
